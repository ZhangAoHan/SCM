/*****************************************************************************************
*文件名称：main.c
*说明：温度采集节点主函数文件
*功能：管理各驱动函数实现无线温度采集
*修改：无
*版本：V1.0.0
*作者：YuanDong
*时间：2009.07.03
*****************************************************************************************/
#include "nRF905.h"
#include "ds18b20.h"
#include "Include.h"
/**********************变量定义*****************************************/
uchar TxMemory[80];		//无线发送数据缓冲区	
uchar TxRxd=0;				//寄存器接收指针
uchar TxTxd=0;				//寄存器发送指针
uchar TxZuShu=0;			//每包发送的组数
uint  TxBufGeShu=0;		//无线接收寄存器中未发送完的个数
uchar TXFlag=0;				//包结束标志位
extern void nRF_Delay(uint time);  //延时函数,单位一个时钟周期
/*****************************************************************************************
*函数名称：CPU_Init(void)
*函数功能：系统初始化
*函数入口：无
*函数出口：无
*****************************************************************************************/
void cpu_Init(void)
{
	nRF905_Init();			 //nRF905初始化
	ds18b20_init()；     //ds18b20初始化
	serial_Init();       //串口通信初始化
	sei();
}
/*****************************************************************************************
*函数名称：DataDispose(uchar num)
*函数功能：数据处理子函数
*函数入口：要处理的缓冲区数据个数num
*函数出口：无
*****************************************************************************************/
void DataDispose(uchar num)
{
	uchar i;
  for(i=0;i<num;i++)
	{
		TxdBuf[i]=TxMemory[TxTxd];
		TxTxd++;
		if(TxTxd>79)	
			 TxTxd=0;
		TxBufGeShu--;						      //发送了1个字节，个数减1
	}

	TxdBuf[4]=(TxZuShu<<4)|num;			//标志字节，高位是组号，低位是这组里的字节个数
	TxZuShu++;
	if(TxZuShu>15)	
		 TxZuShu=0;
	for(i=0;i<3;i++)
	{
 		nRF905_SendData();
	}
}
/*****************************************************************************************
*函数名称：ReceiveEnd(void)
*函数功能：从nRF905接收完一包数据后，数据处理子函数
*函数入口：无
*函数出口：无
*****************************************************************************************/
void ReceiveEnd(void)
{
	if(TxBufGeShu>=4)						//还可以分组
		for(;TxBufGeShu>=4;)
			DataDispose(4);					//整组，每组为四个字节		
	if(TxBufGeShu>0)						//分完组后剩余的字节，不多于4个
	{
		DataDispose(TxBufGeShu);
	}

	TXFlag=0;
	sei();			         			//开总中断
}
/*****************************************************************************************
*函数名称：TxdMain(void)
*函数功能：向nRF905发送数据主函数
*函数入口：无
*函数出口：无
*****************************************************************************************/
void TxdMain(void)
{
	if(TXFlag==1)
		ReceiveEnd();
	else 
	{
		if(TxBufGeShu>=4)				//接收并积累够4个字节后，分组发送
			DataDispose(4);				//整组，每组为四个字节
	}
}
/*****************************************************************************************
*函数名称：main(void)
*函数功能：主函数
*函数入口：无
*函数出口：无
*****************************************************************************************/
void main(void)
{
	uchar i;
	CPU_Init();						//CPU初始化
	for(i=0;i<79;i++)
		TxMemory[i]=i;
	while(1)
	{
		TxBufGeShu=79;
		TXFlag=1;
		TxdMain();
		nRF_Delay(50);
	}
}
