/***********************************************
* 文件名称：LM041L.c							   
* 功能：
* 当前版本：1.0
* 作者：YuanDong
* 完成日期：2009年6月18日
*************************************************/
/*************************************************
* 函数名称：延时子程序
* 功    能：延时一段时间，保证指令的写操作完成
* 入口参数：uint n
* 出口参数：无
**************************************************/
#define LCD_GLOBAL  1
#include "LM041L.h"

void delay(uint n)
{
  uint cc;
  while(n --> 0)
  {  for(cc = 50;cc>0;cc--); }	
}
 
/*************************************************
* 函数名称：读lcd状态指令
* 功    能：读LCD是否忙，若忙则把D7置1
* 入口参数：无
* 出口参数：无
**************************************************/
void recom()
{
   EN = 0;
   RS = 0;
   RW = 1;
   EN = 1;
}
	
/***************************************************
* 函数名称：测试是否忙
* 功    能：保证LCD处于空闲状态
* 入口参数：无
* 出口参数：无
***************************************************/
void busytest()
{
   LCD_DATA = 0xff;
   RS = 0;
   RW = 1;
   EN = 1;
   while((LCD_DATA&0x80) == 0x80)	 //若忙则一直循环
   {
     EN = 0;  //这两句protues仿真必须加
     EN = 1;  
   }
   EN = 0;
}

/*****************************************************
* 函数名称：写lcd指令和数据,DATA或者COMM
* 功    能：根据MODE的类型执行写数据或是写指令操作
* 入口参数：mode（模式），n（数据或是指令）
* 出口参数：无
******************************************************/
void wrlcd(uchar mode,uchar n)
{
   busytest();
   if(mode == DATA)
     RS = 1; 		 
   else if(mode == COMM)
     RS = 0; 
   RW = 0;
   LCD_DATA = n;
   EN = 1;
   _nop_();
   EN=0;
}

/*******************************************************
* 函数名称：清屏
* 功    能：防止花屏
* 入口参数：无
* 出口参数：无
********************************************************/
void clrscr()
{
   wrlcd(COMM,0x01);
}

/********************************************************
* 函数名称：初始化lcd
* 功    能：执行清屏，光标显示设置等操作
* 入口参数：无
* 出口参数：无
*********************************************************/
void initlcd(void)
{
 delay(150);
 wrlcd(COMM,0x38);
 delay(50);
 wrlcd(COMM,0x38);
 delay(50);
 wrlcd(COMM,0x38);
 wrlcd(COMM,0x38);
 
 wrlcd(COMM,0x08);  //关显示 不显示光标
 wrlcd(COMM,0x01);	//清屏
 wrlcd(COMM,0x06);	//光标模式
 wrlcd(COMM,0x0c);  //开显示
}

/*********************************************************
* 函数名称：设置光标位置
* 功    能：测试LCD的状态，根据X,Y的值确定光标的位置
* 入口参数：x,y
* 出口参数：
*********************************************************/
void setpos(uchar x,uchar y)
{
    busytest();
    y&=0x0f;
    x&=0x03;
    if(x == 0x00)
       wrlcd(COMM,y | 0x80);
    else if(x == 0x01)
       wrlcd(COMM,(y + 0x40) | 0x80);
	else if(x == 0x02)
	   wrlcd(COMM,(y + 0x10) | 0x80);  
	else if(x == 0x03)
	   wrlcd(COMM,(y + 0x50) | 0x80); 
}

/**********************************************************
* 函数名称：写字符串数据
* 功    能：
* 入口参数：
* 出口参数：
***********************************************************/
void wrstrdat(uchar x,uchar y,uchar *s,uint length)	
{
 int i,j,k;
 int XMAX,YMAX[4]; 
 if((length + y + x*16 > 48)&(length + y + x*16 < 64))
 {
   XMAX = 4;
   YMAX[0] = 16;
   YMAX[1] = 16;
   YMAX[2] = 16;
   YMAX[3] = y + length + x*16 - 48;
 }		
 else if((length + y + x*16 > 32)&(length + y + x*16 < 48)) 
 {
   XMAX = 3;
   YMAX[0] = 16;
   YMAX[1] = 16;
   YMAX[2] = x*16 + y + length - 32;
   YMAX[3] = 0;
 }  
 else if((length + y + x * 16 > 16)&(length + y + x * 16 < 32))
 {
   XMAX = 2;
   YMAX[0] = 16;
   YMAX[1] = y + length + x * 16 - 16;
   YMAX[2] = 0;
   YMAX[3] = 0;
 }
 else if(length + y + x * 16 < 16)
 {
   XMAX = 1;
   YMAX[0] = y + length + x * 16;
   YMAX[1] = 0; 
   YMAX[2] = 0;
   YMAX[3] = 0;
 }
 else
 {
   XMAX = 4;
   YMAX[0] = 16;
   YMAX[1] = 16;
   YMAX[2] = 16;
   YMAX[3] = 16;
 }
 for(i = x;i < XMAX;i++)
    { if(i != x)
        k = 0;
      else 
        k = y; 
      for(j = k;j < YMAX[i];j++)
        { if((i >= 0x03) & (j > 0x0F)) 
		  {
		   while(1); 
		  }
		  else
		  {    
          setpos(i,j);
          wrlcd(DATA,*s); 
          s++; 
		  }
        }
	}
}