/**************************************************
*文件名称：serialTest.c
*文件功能：实验板串口模块测试程序
*版本：V0.0.1
*作者：yd
*时间：09.07.22
*说明：本测试程序适用于实验板上的RS232和RS485的单机
通信,应用查询式
***************************************************/
#include <AT89X52.h>
#define uchar unsigned char
#define uint  unsigned int
#define sei() (EA =1)
#define cli() (EA =0)
/********************************************************************************************
* 函数名称：Delay(uint a)
* 功    能：延迟时间=a*1ms
* 入口参数：
* 出口参数：无
*********************************************************************************************/
void Delay(uint a)
{
   uchar  i;
   while(a--)
   for(i=0;i<125;i++);
}
/*********************************************
*函数名称：usart0_Initial(void)
*函数功能：初始化串口
*入口函数：无
*出口函数：无
*********************************************/
void usart_Initial(void)
{ 
/************TH1=256-(K*oscFreq)/384*BaudRate************/
	SCON=0x50;   //SM0=0;SM1=1;REN=1;
	TI=0;        //数据发送状态清零
	RI=0;		 //数据接收状态清零 
	PCON=0;		 //不加倍
	TH1=0xF3;	 //bode=2400
	TL1=0XF3;
	TMOD=0X20;	 //TIMER1 MODER2;
	ET1=0;		 //屏蔽timer1溢出中断
	TR1=1;		 //启动timer1
	ES=0;		 //屏蔽串口中断
}
/*********************************************
*函数名称：send_char(uchar txd) 
*函数功能：串口发送一个字符
*入口函数：要发送的一个字符txd
*出口函数：无
*********************************************/
void send_char(uchar txd) 
{
   TI=0;
   SBUF=txd;
   while(!TI);				// 等特数据传送
   TI=0;					// 清除数据传送标志
}
/********************************************
*函数名称：get_char(void)
*函数功能：串口接收一个字符
*函数入口：串口发送的字符rxd
*函数出口：无
********************************************/
uchar get_char(void)
{
   uchar temp;
   RI=0;
   while(!RI);	 // 等特数据传送
   temp=SBUF;
   RI=0;		 // 清除数据传送标志 
   return temp;
}
void main()
{
  uchar temp;
  usart_Initial();
  while(1)
  {
    send_char('A'); 
	Delay(10);
	temp =get_char();
  }
}